## library_in_sysroot/conf/local.conf
```bitbake
# This is a part of the local.conf file

# ...

CORE_IMAGE_EXTRA_INSTALL += "mylib-staticdev hello-world"
```

## library_in_sysroot/meta-foo/conf/layer.conf
```bitbake
# We have a conf and classes directory, add to BBPATH
BBPATH .= ":${LAYERDIR}"

# We have recipes-* directories, add to BBFILES
BBFILES += "${LAYERDIR}/recipes-*/*/*.bb \
	${LAYERDIR}/recipes-*/*/*.bbappend"

BBFILE_COLLECTIONS += "libtest1"
BBFILE_PATTERN_lab1 = "^${LAYERDIR}/"
BBFILE_PRIORITY_lab1 = "6"
```
